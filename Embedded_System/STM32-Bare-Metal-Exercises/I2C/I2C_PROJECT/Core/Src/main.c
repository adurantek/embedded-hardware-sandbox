#include <stdint.h>
#include <stdio.h>
#include <sys/_intsup.h>
#include "stm32c031xx.h"
#include "stm32c0xx.h"

uint8_t read_value1;
uint8_t read_value;

const uint8_t Font5x7[] = {
	0x00, 0x00, 0x00, 0x00, 0x00,// (space)
	0x00, 0x00, 0x5F, 0x00, 0x00,// !
	0x00, 0x07, 0x00, 0x07, 0x00,// "
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	0x08, 0x1C, 0x2A, 0x08, 0x08 // <- **96th
};

void setup (void) {
	RCC -> CR &= ~(1 << 12); 										//CONFIGURED FREQUENCY TO 48MHZ

	RCC -> IOPENR |= (1 << 1);  									//PORT B ENABLE
	RCC -> APBENR1 |= (1 << 21); 									//I2C1 PERHIPRAL ENABLE

	GPIOB -> MODER &= ~((1 << 16) | (1 << 18)); 					//PB8 AND PB9 AF ENABLE
	GPIOB -> OTYPER |= ((1 << 8) | (1 << 9));   					//OPEN-DRAİN ENABLE
	GPIOB -> AFR[1] |= ((1 << 1) | (1 << 2) | (1 << 5) | (1 << 6)); //SCL AND SDA ENABLE (DATASHEET PAGE 37)

	//100Khz for 48Mhz Table 115.

	I2C1 -> TIMINGR |= ((0xB << 28)   //PRESC
					|  (0x13 << 0)    //SCLL
					|  (0xF << 8)     //SCLH
					|  (0x2 << 16)    //SDADEL
					|  (0x4 << 20));  //SCLDEL

	I2C1 -> CR1 |= (1 << 0);	 	  //PERHIPRAL ENABLE

}

uint8_t BMP180_Read_Byte(void) {
	I2C1 -> CR2 =	 ((0x77 << 1)  //SADD (BMP180 ADDRESS)
				    |  (1 << 16)   //NBYTE (1 byte)
					|  (1 << 13)); //START
	while((I2C1 -> ISR & (1 << 1)) == 0) /* TXIS FLAG CONTROL */ { } //WHAT IS DOING IF TXIS FLAG IS NOT SET? JUST WAITING UNTIL TXIS FLAG IS SET
	I2C1 -> TXDR = 0xD0;
	while((I2C1 -> ISR & (1 << 6)) == 0) /* COMPLETE FLAG CONTROL */ { }
	I2C1 -> CR2 = 	((0x77 << 1)  //SADD (BMP180 ADRESS)
					| (1 << 16)   //NBYTES (1 Byte)
					| (1 << 10)   //READ MODE
					| (1 << 13)); //START
	while((I2C1->ISR & (1 << 2)) == 0) /* RXNE FLAG CONTROL */ { } //WHAT IS DOING IF RXNE FLAG IS NOT SET? JUST WAITING UNTIL RXNE FLAG IS SET
	read_value = I2C1->RXDR;
	I2C1->CR2 |= (1 << 14); //STOP
	return read_value; 
	}

void I2C_Write_Byte(uint8_t *data_array, uint8_t adres, uint8_t size) {
	I2C1 -> CR2	=     ((adres << 1)  //SADD (SENSOR ADDRESS)
				    |  (size << 16)  //NBYTE (size byte)
					|  (1 << 13));   //START
	// NOTE: READ/WRİTE 0 DEFAULT
	
	for (uint8_t i=0; i < size; i++) {
	while((I2C1 -> ISR & (1 << 1)) == 0) /* TXIS FLAG CONTROL */ { } //WHAT IS DOING IF TXIS FLAG IS NOT SET? JUST WAITING UNTIL TXIS FLAG IS SET
	I2C1 -> TXDR = data_array[i];
	}
	while((I2C1 -> ISR & (1 << 6)) == 0) /* COMPLETE FLAG CONTROL */ { }
	I2C1 -> CR2 |= (1 << 14); //STOP
}

void clear_pixels() {
	uint8_t clear_list[129];  											// 1 CONTROL BYTE + 128 PIXELS
	clear_list[0] = 0x40;     											//CONTROL BYTE (D/C# = 1) (DATASHEET)

	for (uint8_t i=1;i<129;i++) {
		clear_list[i] = 0x00; 											//PIXEL DATA (0x00 = BLACK, 0xFF = WHITE)
	}

	for (uint8_t j=0;j<8;j++) {
		I2C_Write_Byte(clear_list,0x3C,129);
	}
}

void OLED_PutChar(char c) {
	uint16_t index = (c - 32)*5;
	uint8_t charr[7]; 													// 1 CONTROL BYTE + 5 FONT BYTES + 1 SPACE BYTE
	charr[0] = 0x40;
	for (uint8_t i=1;i<6;i++) { charr[i] = Font5x7[index + (i - 1)]; }
	charr[6] = 0x00; 													//SPACE BETWEEN CHARACTERS
	I2C_Write_Byte(charr,0x3C,7);
}

void Set_Cursor(uint8_t column, uint8_t page) {
	uint8_t list[7] = {
		0x00, 										//CONTROL (D/C# = 0) (DATASHEET)
		0x21, column, 127,  						//CONFIGURE HORIZONTAL (SSD1306 DATASHEET PAGE 30)
		0x22, page, 3 								//CONFIGURE VERTICAL (SSD1306 DATASHEET PAGE 31)
	};

	I2C_Write_Byte(list,0x3C,7);
}

void OLED_Open() {
	//OLED SCREEN ADRESSES
	uint8_t oled_init_cmd[27] = {
		0x00,       // CONTROL BYTE
	    0xAE,       // (Display OFF)
	    0xD5, 0x80, // CLOCK FREQUENCY CONFIG
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	    0xA6,       // NORMAL DISPLAY (0xA7 = INVERTED DISPLAY)
	    0xAF        // ENABLE DISPLAY
	};
	I2C_Write_Byte(oled_init_cmd, 0x3C, 27);
}

void OLED_Print(char *str) {
	while (*str) {
		OLED_PutChar(*str);
		str++;
	}
}

int main (void) {
	setup();
	OLED_Open();
	Set_Cursor(0,0);
	clear_pixels();
	
	read_value1 = BMP180_Read_Byte();
	
	char text[50];
	uint8_t value = read_value1;
	sprintf(text,"Read Value : %x",value); //SPRINTF FUNCTION TO CONVERT INT TO STRING (!BUT HEAVY FUNCTION!)
	
	OLED_Print(text);

	while (1) {}
}
